## workspace/modules/mcp9808/drivers/sensor/mcp9808/Kconfig
```kconfig
menuconfig MCP9808
	bool "MCP9808 Temperature Sensor"
	default y
	select I2C
	help
	  Enable driver for the MCP9808 temperature sensor.
```

## workspace/modules/mcp9808/dts/bindings/sensor/microchip,mcp9808.yaml
```yaml
description: |
  Microchip MCP9808 temperature sensor

compatible: "microchip,mcp9808"

include: [sensor-device.yaml, i2c-device.yaml]

properties:
  resolution:
    type: int
    default: 3
    description: |
      Sensor resolution. Default is 0.0625°C (3).
    enum:
      - 0 # 0.5C
      - 1 # 0.25C
      - 2 # 0.125C
      - 3 # 0.0625C
```
